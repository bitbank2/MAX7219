#include <Arduino.h>
//#define USE_SPI
#include <max7219.h>
#ifdef USE_SPI
#include <SPI.h>
#endif
#include <avr/pgmspace.h>
//
// MAX7219 LED Matrix controller library
// Copyright (c) 2018 BitBank Software, Inc.
// Written by Larry Bank
// bitbank@pobox.com
// Project started 3/10/2018
//
// I purchased a 4-module unit of red 8x8 LED matrices. They're wired such that the leftmost module is the last
// in the chain and the bits are arranged such that the MSB is on the left and row 0 is the top row.
//
// This library contains a basic set of functions to initialize the modules, set the intensity, draw text in 2 font
// sizes and scroll a bitmap (which can contain text or any graphics you put there
//
// The modules are connected to digital outputs (bit-banging) or the SPI clock and data lines as well as 1 digital
// .output pin to control the latching of the data.
// The SPI CS line is not sufficient to properly control the loading of the data. Each module expects
// to receive 16-bits of data at a time with D15 sent first and D0 sent last. The data contains an instruction in
// D11-D8 and data for that instruction in D7-D0. In my case of 4 modules cascaded together, a data stream of
// 16 x 4 = 64 bits must be transmitted at a time to latch data to all modules simultaneously. The controllers
// randomly power up in test mode (all LEDs on at their brightest). For this reason, the init function disables
// test mode just in case.
//
// Each module shifts bits in and the next bit is shifted out. For example, in the case of my setup with 4 modules
  const byte ucFont[] PROGMEM = {0x00,0x00,0x00,0x00,0x00,0x00,0x00,0x00,0x7e,0x81,0x95,0xb1,0xb1,0x95,0x81,0x7e,
  0x7e,0xff,0xeb,0xcf,0xcf,0xeb,0xff,0x7e,0x0e,0x1f,0x3f,0x7e,0x3f,0x1f,0x0e,0x00,
  0x08,0x1c,0x3e,0x7f,0x3e,0x1c,0x08,0x00,0x38,0x9a,0x9f,0xff,0x9f,0x9a,0x38,0x00,
  0x10,0xb8,0xfc,0xfe,0xfc,0xb8,0x10,0x00,0x00,0x00,0x18,0x3c,0x3c,0x18,0x00,0x00,
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  0x02,0x03,0x01,0x03,0x02,0x03,0x01,0x00,0x70,0x78,0x4c,0x46,0x4c,0x78,0x70,0x00};

// 5x7 font (in 6x8 cell)
const byte ucSmallFont[] PROGMEM= {0x00,0x00,0x00,0x00,0x00,0x00,0x00,0x3e,0x45,0x51,0x45,0x3e,0x00,0x3e,0x6b,0x6f,
  0x6b,0x3e,0x00,0x1c,0x3e,0x7c,0x3e,0x1c,0x00,0x18,0x3c,0x7e,0x3c,0x18,0x00,0x30,
  0x36,0x7f,0x36,0x30,0x00,0x18,0x5c,0x7e,0x5c,0x18,0x00,0x00,0x18,0x18,0x00,0x00,
  0x00,0xff,0xe7,0xe7,0xff,0xff,0x00,0x3c,0x24,0x24,0x3c,0x00,0x00,0xc3,0xdb,0xdb,
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  0x41,0x41,0x3e,0x08,0x00,0x02,0x01,0x02,0x01,0x00,0x00,0x3c,0x26,0x23,0x26,0x3c};

static byte bNumControllers;
static byte bClockPin, bDataPin, bSelectPin;

#ifndef USE_SPI
static void myspi_transfer(byte *p, byte len)
{
byte b, i, j;

   for (i=0; i<len; i++)
   {
      b = p[i]; // data to transmit 
     for (j=0; j<8; j++)
     {
        digitalWrite(bClockPin, LOW);
        digitalWrite(bDataPin, (b & 0x80) ? HIGH: LOW);
        // An extra delay here isn't necessary since the Max7219 can handle the data rate of
        // the max bit-flipping speed of a 16Mhz AVR
        digitalWrite(bClockPin, HIGH);
        b <<= 1; // transmit MSB first
     } // for j
   } // for i

} /* myspi_transfer() */
#endif // !USE_SPI
//
// Transmit a sequence of N x 16 bits to the cascaded controllers
//
// Send an atomic sequence of bytes for loading all chained controllers (16 bits per controller)
// Each controller acts like a 16-bit shift register and passes on the bits to the next controller. The
// last 16-bits to sit in the controller will be latched when the CS line goes high.
// byte 0 -> D15-D8 (XXXX A3 A2 A1 A0), 4-bits unused and 4-bit register address
// byte 1 -> D7-D0 (8-bit data)
//
static void maxSendSequence(byte *pSequence, byte len)
{
  // The CS line stays low throughout a "transaction". Send all of the control bytes for all of the chained
  // controllers in a single transaction. When the CS line rises, the data will be latched
   digitalWrite(bSelectPin, LOW); // 1Mhz is a good speed for the max7219
#ifdef USE_SPI
   SPI.transfer(pSequence, len);
#else
   myspi_transfer(pSequence, len);
#endif
   digitalWrite(bSelectPin, HIGH);
   
} /* maxSendSequence() */

//
// Power on or off the LED controllers
//
void maxPowerUp(byte bPowerUp)
{
byte i;
byte *d, bTemp[32]; // up to 16 controllers
  d = bTemp;
  for (i=0; i<bNumControllers; i++)
  {
     *d++ = 0x0C; // power up/down
     *d++ = bPowerUp;
  }
  maxSendSequence(bTemp, bNumControllers * 2); // send the power up/down instruction
} /* maxPowerUp() */
//
// Set the LED intensity
// 0 (min) to 15 (max)
//
void maxSetIntensity(byte bIntensity)
{
byte *d, bTemp[32];
byte i;

  if (bIntensity > 15) bIntensity = 15;
  
  d = bTemp;
  for (i=0; i<bNumControllers; i++)
  {
      *d++ = 0x0A; // set intensity
      *d++ = bIntensity;
  } // for i
  maxSendSequence(bTemp, bNumControllers * 2);
} /* maxSetIntensity() */
//
// Set the segment decode mode (BCD or none)
//
void maxSetSegmentMode(byte bMode)
{
byte i, *d, bTemp[32];

  d = bTemp;
  for (i=0; i<bNumControllers; i++)
  {
      *d++ = 0x09; // decode mode
      *d++ = bMode;
  } // for i
  maxSendSequence(bTemp, bNumControllers * 2); // send the scan limit instructions to all controllers
} /* maxSetSegmentMode() */

//
// Send image data to the array of controllers
// The image data is transmitted as N by 8 lines tall (N is the number of MAX7219 controllers)
// The pitch (bytes per line) can be any value
//
void maxSendImage(byte *pImage, int iPitch)
{
byte i, j;
byte *s, *d, bTemp[32];

   for (j=0; j<8; j++) // 8 rows to transmit
   {
      s = &pImage[iPitch * j];
      d = bTemp;
      for (i=0; i<bNumControllers; i++)
      {
         *d++ = (j+1); // row number is the "instruction"
         *d++ = *s++; // image data
      } // for each controller
      maxSendSequence(bTemp, bNumControllers * 2);
   } // for each row of image
} /* maxSendImage() */

//
// Enable (1) or disable (0) test mode
// This mode lights up every LED at max brightness
// It can sometimes power up in test mode
//
void maxSetTestMode(byte bOn)
{
byte i, *d, bTemp[32];

  d = bTemp;
  for (i=0; i<bNumControllers; i++)
  {
      *d++ = 0x0F; // test mode
      *d++ = bOn;
  } // for i
  maxSendSequence(bTemp, bNumControllers * 2); // send the scan limit instructions to all controllers
} /* maxSetTestMode() */
//
// Number of "digits/rows" to control
// valid values are 0-7 (corresponds to 1-8 active digits/rows)
//
void maxSetLimit(byte bLimit)
{
byte i, *d, bTemp[32];

  d = bTemp;
  for (i=0; i<bNumControllers; i++)
  {
      *d++ = 0x0B; // set scan limit
      *d++ = (bLimit - 1);
  } // for i
  maxSendSequence(bTemp, bNumControllers * 2); // send the scan limit instructions to all controllers
} /* maxSetLimit() */

//
// Draw a string of characters into the image buffer
// Normal characters are 8x8 and drawn on byte boundaries
// Small characters are 6x8 and drawn on bit boundaries
//
void maxDrawString(char *pString, byte *pImage, byte iPitch, byte bSmall)
{
byte b, bMask, i, j, *d, bCol;
const byte *pFont;
const byte *s;
byte bTemp[8];
int iWidth;

   d = pImage;
   bCol = 0;
   if (bSmall)
   {
      pFont = ucSmallFont;
      iWidth = 6;
   }
   else
   {
      pFont = ucFont;
      iWidth = 8;
   }
   while (*pString)
   {
      b = *pString++;
      s = &pFont[(int)b * iWidth]; // 6 or 8 bytes per character in ASCII order
      memcpy_P(bTemp, s, iWidth); // copy from FLASH memory
      for (i=0; i<iWidth; i++) // column
      {
         bMask = (0x80 >> (bCol & 7));
         b = bTemp[i]; // current font byte
         for (j=0; j<8; j++) // bit number of source becomes destination row
         {
            if (b & 1) // start from LSB
               d[j*iPitch] |= bMask;
            else
               d[j*iPitch] &= ~bMask;
            b >>= 1; // shift down font byte
         } // for j
         bCol++;
         if ((bCol & 7) == 0) // next byte
            d++;
      } // for i
   } // while string
} /* maxDrawString() */

//
// Scroll a bitmap N bits left (positive) or right (negative)
// Valid scroll values are +1 to +7 and -1 to -7
// A bitmap is assumed to be iPitch bytes wide by 8 rows tall
// Bits which scroll off one end are added back to the other end
//
void maxScrollBitmap(byte *pBitmap, int iPitch, int iScroll)
{
byte b, bEdge, *s;
int col, row;

  if (iScroll > 0) // scroll left
  {
     for (row=0; row<8; row++)
     {
        s = &pBitmap[row * iPitch];
        bEdge = s[0] >> (8-iScroll);
        for (col=0; col<iPitch; col++)
        {
           b = s[col] << iScroll;
           b |= (col == iPitch-1) ? bEdge : (s[col+1] >> (8-iScroll));
           s[col] = b;
        } // for col
     } // for row
  }
  else // scroll right
  {
     iScroll = 0 - iScroll; // make it a positive number
     for (row=0; row<8; row++)
     {
        s = &pBitmap[row * iPitch];
        bEdge = s[iPitch-1] << (8-iScroll);
        for (col=iPitch-1; col>=0; col--)
        {
           b = s[col] >> iScroll;
           b |= (col == 0) ? bEdge : (s[col-1] << (8-iScroll));
           s[col] = b;
        } // for col
     } // for row    
  }
} /* maxScrollBitmap() */
//
// Initialize the controllers
//
void maxInit(byte iNum, byte bDecodeMode, byte bClk, byte bData, byte bSel)
{

  bNumControllers = iNum;
  bClockPin = bClk;
  bDataPin = bData;
  bSelectPin = bSel;
  
  pinMode(bSelectPin, OUTPUT);
  digitalWrite(bSelectPin, HIGH);
#ifndef USE_SPI
  pinMode(bClockPin, OUTPUT);
  pinMode(bDataPin, OUTPUT);
#endif
  maxPowerUp(1); // turn on the LED controllers
  maxSetLimit(8); // tell it to display 8 rows of 8 pixels
  maxSetIntensity(0); // set the minimum intensity to start (1/32 duty cycle)
  maxSetSegmentMode(bDecodeMode); // sets BCD (7-segment), or none (pixels
  maxSetTestMode(0); // disable test mode (it can accidentally get set at power up) 
} /* maxInit() */

